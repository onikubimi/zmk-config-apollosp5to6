#include "apollosp5to6.dtsi"

&kscan0 {
    row-gpios
        = <&gpio0 6  (GPIO_ACTIVE_LOW | GPIO_PULL_UP)> // Row 0
        , <&gpio0 8  (GPIO_ACTIVE_LOW | GPIO_PULL_UP)> // Row 1
        , <&gpio0 24 (GPIO_ACTIVE_LOW | GPIO_PULL_UP)> // Row 2
        , <&gpio1 4  (GPIO_ACTIVE_LOW | GPIO_PULL_UP)> // Row 3
        , <&gpio1 6  (GPIO_ACTIVE_LOW | GPIO_PULL_UP)>; // Row 4

    col-gpios
        = <&gpio0 17 GPIO_ACTIVE_LOW> // Col 0
        , <&gpio0 20 GPIO_ACTIVE_LOW> // Col 1
        , <&gpio0 22 GPIO_ACTIVE_LOW> // Col 2
        , <&gpio0 29 GPIO_ACTIVE_LOW> // Col 3
        , <&gpio0 11 GPIO_ACTIVE_LOW> // Col 4
        , <&gpio0 31 GPIO_ACTIVE_LOW> // Col 5
        , <&gpio0 9  GPIO_ACTIVE_LOW>; // Col 6
};
