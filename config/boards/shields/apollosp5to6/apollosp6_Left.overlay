#include "apollosp5to6.dtsi"

&kscan0 {
        diode-direction = "row2col";
        row-gpios
           = <&gpio0 6  GPIO_ACTIVE_LOW> // Row 0
           , <&gpio0 8  GPIO_ACTIVE_LOW> // Row 1
           , <&gpio0 24 GPIO_ACTIVE_LOW> // Row 2
           , <&gpio1 4  GPIO_ACTIVE_LOW> // Row 3
           , <&gpio1 6  GPIO_ACTIVE_LOW>; // Row 4
        col-gpios
           = <&gpio0 17 (GPIO_ACTIVE_LOW | GPIO_PULL_UP)> // Col 0
           , <&gpio0 20 (GPIO_ACTIVE_LOW | GPIO_PULL_UP)> // Col 1
           , <&gpio0 22 (GPIO_ACTIVE_LOW | GPIO_PULL_UP)> // Col 2
           , <&gpio0 29 (GPIO_ACTIVE_LOW | GPIO_PULL_UP)> // Col 3
           , <&gpio0 11 (GPIO_ACTIVE_LOW | GPIO_PULL_UP)> // Col 4
           , <&gpio0 31 (GPIO_ACTIVE_LOW | GPIO_PULL_UP)> // Col 5
           , <&gpio0 9  (GPIO_ACTIVE_LOW | GPIO_PULL_UP)>; // Col 6
};
