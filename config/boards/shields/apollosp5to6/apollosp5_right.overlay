#include "apollosp5.dtsi"

&default_transform {
    col-offset = <7>;
};

&kscan0 {
    row-gpios
        /* 2. 行側を「読み取り」に設定し、PULL_DOWN（通常は0V）にする */
        = <&gpio0 17 (GPIO_ACTIVE_HIGH | GPIO_PULL_DOWN)>
        , <&gpio0 20 (GPIO_ACTIVE_HIGH | GPIO_PULL_DOWN)>
        , <&gpio0 31 (GPIO_ACTIVE_HIGH | GPIO_PULL_DOWN)>
        , <&gpio0 29 (GPIO_ACTIVE_HIGH | GPIO_PULL_DOWN)>
        , <&gpio0 2  (GPIO_ACTIVE_HIGH | GPIO_PULL_DOWN)>;

    col-gpios
        /* 3. 列側を「出力（HIGH）」にする */
        = <&gpio0 9  GPIO_ACTIVE_HIGH>
        , <&gpio0 10 GPIO_ACTIVE_HIGH>
        , <&gpio1 11 GPIO_ACTIVE_HIGH>
        , <&gpio1 13 GPIO_ACTIVE_HIGH>
        , <&gpio1 15 GPIO_ACTIVE_HIGH>
        , <&gpio0 8  GPIO_ACTIVE_HIGH>
        , <&gpio0 6  GPIO_ACTIVE_HIGH>;
};


    &right_encoder {
        status = "okay";
    };

    &sensors {
        sensors = <&right_encoder>;
    };
