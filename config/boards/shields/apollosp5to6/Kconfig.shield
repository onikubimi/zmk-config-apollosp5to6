## config/boards/shields/apollosp5to6/Kconfig.shield
```kconfig
config SHIELD_APOLLOSP6_LEFT
    def_bool $(shields_list_contains,apollosp6_left)

config SHIELD_APOLLOSP5_RIGHT
    def_bool $(shields_list_contains,apollosp5_right)
```

## config/west.yml
```yaml
manifest:
  defaults:
    revision: v0.3
  # revision: main
  remotes:
    - name: zmkfirmware
    # url-base: https://github.com/onikubimi
      url-base: https://github.com/zmkfirmware
  projects:
    - name: zmk
      remote: zmkfirmware
      import: app/west.yml
  self:
    path: config
```
